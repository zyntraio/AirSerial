## firmware-idf/components/board/Kconfig
```kconfig
menuconfig BOARD
    bool "Board configuration"
    default y
    help
        AirSerial 板级配置选择。
        选板后 board 组件会自动编译对应的 board_xxx.c 源文件。

if BOARD

choice BOARD_TYPE_CHOICE
    prompt "Target board"
    default BOARD_TYPE_STICKS3
    help
        用 idf.py set-board <suffix> 可以快速切换:
          sticks3 → sdkconfig.defaults.sticks3
          n16r8   → sdkconfig.defaults.n16r8

    config BOARD_TYPE_STICKS3
        bool "M5Stack StickS3"
        help
            单 Type-C (USB-SERIAL-JTAG + OTG 共享 PHY), SHARED_PHY topo
            8MB Flash, 8MB PSRAM (Quad), USB-SERIAL-JTAG console

    config BOARD_TYPE_N16R8
        bool "N16R8 公模板子"
        help
            双 Type-C, CH343 GPIO43/44 + 直通 OTG, INDEPENDENT topo
            16MB Flash, 8MB PSRAM (Octal), UART0 GPIO43/44 console

    config BOARD_TYPE_CARD_PUTER_ADV
        bool "M5Stack Cardputer-Adv"
        help
            单 Type-C SHARED_PHY (USB-SERIAL-JTAG + OTG 共享 PHY)
            Stamp-S3A 核心 (ESP32-S3FN8), 8MB Flash, 无外部 PSRAM
            ST7789V2 1.14" 屏幕 + TCA8418 56 键键盘
            USB-SERIAL-JTAG GPIO19/20 console
endchoice

endif
```

## firmware-idf/main/Kconfig.projbuild
```kconfig
menu "AirSerial peripheral options"

    config AIRSERIAL_HAVE_DISPLAY
        bool "Display panel"
        default y
        help
            板载显示屏。关闭后整个 ui 组件与 LVGL 不参与编译，
            设备以 headless 模式运行，仅靠 USB Host + WiFi 提供桥接。

    config AIRSERIAL_HAVE_TOUCH
        bool "Touchscreen"
        depends on AIRSERIAL_HAVE_DISPLAY
        default y
        help
            触摸屏（含屏上终端所需的触摸输入）。无触摸时显示仍可用于状态展示。

    config AIRSERIAL_HAVE_KEYBOARD
        bool "External I2C keyboard"
        default y
        help
            外接 I2C 键盘探测（Tab5 专属键盘 / CardKB）。纯锦上添花，
            关闭后不影响任何核心功能。

    config AIRSERIAL_HAVE_SDCARD
        bool "SD card"
        default y
        help
            SD 卡支持。关闭后 bridge.cfg 配置文件来源不可用，
            设备改用 NVS 保存的凭证与编译默认值。

endmenu
```
